## meta-picam/conf/layer.conf
```bitbake
BBPATH .= ":${LAYERDIR}"

BBFILES += "${LAYERDIR}/recipes-*/*/*.bb \
            ${LAYERDIR}/recipes-*/*/*.bbappend"

BBFILE_COLLECTIONS += "picam"
BBFILE_PATTERN_picam = "^${LAYERDIR}/"
BBFILE_PRIORITY_picam = "10"

LAYERDEPENDS_picam = "core openembedded-layer raspberrypi"
LAYERSERIES_COMPAT_picam = "scarthgap"
```
